## CMakeLists.txt
```
# Copyright (C) 2025 Alif Semiconductor - All Rights Reserved.
# Use, distribution and modification of this code is permitted under the
# terms stated in the Alif Semiconductor Software License Agreement
#
# You should have received a copy of the Alif Semiconductor Software
# License Agreement with this file. If not, please write to:
# contact@alifsemi.com, or visit: https://alifsemi.com/license

cmake_minimum_required(VERSION 3.20.0)
find_package(Zephyr REQUIRED HINTS $ENV{ZEPHYR_BASE})
project(le_audio_unicast_source)

target_sources(app PRIVATE
    src/main.c
    src/unicast_source.c
    src/storage.c
    src/audio_datapath.c
    src/scan.c
    src/shell_cmds.c
)
```

## prj.conf
```kconfig
# Copyright (C) 2025 Alif Semiconductor - All Rights Reserved.
# Use, distribution and modification of this code is permitted under the
# terms stated in the Alif Semiconductor Software License Agreement
#
# You should have received a copy of the Alif Semiconductor Software
# License Agreement with this file. If not, please write to:
# contact@alifsemi.com, or visit: https://alifsemi.com/license

CONFIG_BT=y
CONFIG_BT_CUSTOM=y
CONFIG_ALIF_ROM_LC3_CODEC=y
CONFIG_ALIF_BLE_AUDIO=y

CONFIG_LOG=y
CONFIG_ASSERT=y

CONFIG_PRESENTATION_COMPENSATION_DIRECTION_SOURCE=y

# Should be replaced by TRNG when support is available
CONFIG_ENTROPY_GENERATOR=y
CONFIG_TEST_RANDOM_GENERATOR=y

# malloc support is required, simplest way is using newlib although it would also be possible to
# configure heap for picolibc
CONFIG_NEWLIB_LIBC=y

# Driver support for audio
CONFIG_I2S=y
CONFIG_DMA=y

# Audio driver support specific to B1 DK board.
# Audio codec is WM8904, connected via I2C.
CONFIG_I2C=y
CONFIG_WM8904=y
CONFIG_AUDIO=y
CONFIG_AUDIO_CODEC=y
CONFIG_I2C_INIT_PRIORITY=50
CONFIG_WM8904_INIT_PRIORITY=53

# This is specific to whichever clock you use. Currently presentation layer is
# commented out so this does nothing
CONFIG_AUDIO_CLOCK_DIVIDER=1

# Debug
CONFIG_USE_SEGGER_RTT=y
CONFIG_RTT_CONSOLE=y

CONFIG_MAIN_STACK_SIZE=8192
CONFIG_ISR_STACK_SIZE=4096
CONFIG_PRIVILEGED_STACK_SIZE=2048
CONFIG_IDLE_STACK_SIZE=1024
CONFIG_BOOT_BANNER=n
CONFIG_ALIF_BLE_HOST_ADDL_PRF_HEAPSIZE=10240
CONFIG_ALIF_BLE_HOST_ADDL_ENV_HEAPSIZE=8192

# Enable NVS as the backend for Settings
CONFIG_NVS=y
# Enable the Settings subsystem
CONFIG_SETTINGS=y
CONFIG_SETTINGS_NVS=y
CONFIG_SETTINGS_RUNTIME=y
CONFIG_MPU_ALLOW_FLASH_WRITE=y
CONFIG_FLASH=y
CONFIG_FLASH_MAP=y

CONFIG_LE_AUDIO_LATENCY_RELIABLE=y
CONFIG_LE_AUDIO_PRESENTATION_DELAY_MS=30

# For MRAM(XIP) builds with LLVM exception tables cause linker errors as part of the code is placed to TCM
CONFIG_CPP_EXCEPTIONS=n


CONFIG_SHELL=y
```

## src/shell_cmds.c
```c
/** @file
 * @brief Bluetooth Audio shell module
 *
 * Provide some Bluetooth Audio shell commands that can be useful to applications.
 *
 * Copyright (c) 2017 Intel Corporation
 * Copyright (c) 2018 Nordic Semiconductor ASA
 * Copyright (c) Alif Semiconductor
 *
 * Alif Semiconductor version uses the Zephyr's bt shell module as a base
 * but adapts it to the Ceva-Waves' BLE stack.
 *
 * SPDX-License-Identifier: Apache-2.0
 */

#include <zephyr/sys/util.h>
#include <zephyr/sys/printk.h>
#include <zephyr/shell/shell.h>
#include <zephyr/shell/shell_uart.h>
#include <stdlib.h>
#include <string.h>
#include <errno.h>
#include <zephyr/logging/log.h>
#include "unicast_source.h"

//LOG_MODULE_REGISTER(bt_audio_shell, CONFIG_BT_AUDIO_SHELL_LOG_LEVEL);

static int cmd_vol_up(const struct shell *sh, size_t argc, char *argv[])
{
	volume_increase(); 
		
    shell_fprintf(sh, SHELL_NORMAL, "Volume up\n");
	return 0;
}

static int cmd_vol_down(const struct shell *sh, size_t argc, char *argv[])
{
	volume_decrease(); 
	
    shell_fprintf(sh, SHELL_NORMAL, "Volume down\n");	
	return 0;
}

static int cmd_default_handler(const struct shell *sh, size_t argc, char **argv)
{
	if (argc == 1) {
		shell_help(sh);
		return SHELL_CMD_HELP_PRINTED;
	}

    shell_fprintf(sh, SHELL_ERROR, "%s unknown parameter: %s", argv[0], argv[1]);
	
	return -EINVAL;
}

#define HELP_NONE "[none]"

SHELL_STATIC_SUBCMD_SET_CREATE(
	bt_audio_cmds, 
	SHELL_CMD_ARG(vol-up, NULL, HELP_NONE, cmd_vol_up, 0, 0),
	SHELL_CMD_ARG(vol-down, NULL, HELP_NONE, cmd_vol_down, 0, 0),
	SHELL_SUBCMD_SET_END);

SHELL_CMD_REGISTER(bt_audio, &bt_audio_cmds, "Bluetooth audio shell commands", cmd_default_handler);
```

## src/unicast_source.h
```c
/* Copyright (C) 2025 Alif Semiconductor - All Rights Reserved.
 * Use, distribution and modification of this code is permitted under the
 * terms stated in the Alif Semiconductor Software License Agreement
 *
 * You should have received a copy of the Alif Semiconductor Software
 * License Agreement with this file. If not, please write to:
 * contact@alifsemi.com, or visit: https://alifsemi.com/license
 */

#ifndef _UNICAST_SOURCE_H
#define _UNICAST_SOURCE_H

#include <stdint.h>

/**
 * @brief Configure the LE audio unicast source
 *
 * @return 0 on success
 */
int unicast_source_configure(void);

/**
 * @brief Start the service discovery
 *
 * @param con_lid Connection index
 *
 * @return 0 on success
 */
int unicast_source_discover(uint8_t con_lid);

/**
 * @brief Setup the streams for the LE audio unicast source
 *
 * @param con_lid Connection index
 *
 * @return 0 on success
 */
int unicast_setup_streams(uint8_t con_lid);

/**
 * @brief Enable the streams for the LE audio unicast source
 *
 * @param con_lid Connection index
 *
 * @return 0 on success
 */
int unicast_enable_streams(uint8_t con_lid);


void volume_increase(void);
void volume_decrease(void);

#endif /* _UNICAST_SOURCE_H */
```
